## CMakeLists.txt
```
#
# Copyright (c) 2025 Nordic Semiconductor ASA
#
# SPDX-License-Identifier: LicenseRef-Nordic-5-Clause
#

cmake_minimum_required(VERSION 3.20.0)

find_package(Zephyr REQUIRED HINTS $ENV{ZEPHYR_BASE})
project(zbus_uart_forwarder_dev_b)


zephyr_library_include_directories(
    src
    ../common
)

# Define which device this is
zephyr_compile_definitions(ZBUS_DEVICE_B=1)

target_sources(app PRIVATE src/main.c)
```

## prj.conf
```kconfig
# Copyright (c) 2025 Nordic Semiconductor ASA
# SPDX-License-Identifier: LicenseRef-Nordic-5-Clause


CONFIG_LOG=y
# CONFIG_LOG_MODE_MINIMAL=y
CONFIG_LOG_DBG_COLOR_BLUE=y

CONFIG_SERIAL=y
CONFIG_UART_ASYNC_API=y

CONFIG_TEST_RANDOM_GENERATOR=y

CONFIG_UART_1_NRF_ASYNC_LOW_POWER=y
CONFIG_UART_2_NRF_ASYNC_LOW_POWER=y

CONFIG_ZBUS=y

CONFIG_ZBUS_MULTIDOMAIN=y
CONFIG_ZBUS_MULTIDOMAIN_UART=y
CONFIG_ZBUS_MULTIDOMAIN_LOG_LEVEL_DBG=n
```

## src/main.c
```c
#include <zephyr/kernel.h>
#include <zephyr/logging/log.h>
#include <zephyr/random/random.h>
#include <string.h>
#include <zephyr/zbus/zbus.h>
#include <zephyr/zbus/multidomain/zbus_multidomain.h>

#include "common.h"

LOG_MODULE_REGISTER(main, LOG_LEVEL_DBG);

/* NOTE: Shared channels request_channel and response_channel are defined in common.h */

/* Set up proxy agent for UART1 and add response channel to be forwarded */
ZBUS_PROXY_AGENT_DEFINE(uart1_proxy, ZBUS_MULTIDOMAIN_TYPE_UART, uart1);
ZBUS_PROXY_ADD_CHANNEL(uart1_proxy, response_channel);

int get_random_value(int min, int max)
{
    return min + (sys_rand32_get() % (max - min + 1));
}

/* Listen for requests on the request channel, and respond on the response channel */
static void uart_forwarder_listener_cb(const struct zbus_channel *chan)
{
    LOG_INF("Received message on channel %s", chan->name);
    const struct request_data *data = zbus_chan_const_msg(chan);
    LOG_INF("Request ID: %d, Min: %d, Max: %d", data->request_id, data->min_value, data->max_value);

    /* Simulate a response */
    struct response_data response = {
        .response_id = data->request_id,
        .value = get_random_value(data->min_value, data->max_value)
    };

    LOG_INF("Sending response: ID=%d, Value=%d", response.response_id, response.value);

    int ret = zbus_chan_pub(&response_channel, &response, K_MSEC(100));
    if (ret < 0) {
        LOG_ERR("Failed to publish response on channel %s: %d", response_channel.name, ret);
    } else {
        LOG_INF("Response published on channel %s", response_channel.name);
    }
}
ZBUS_LISTENER_DEFINE(uart_forwarder_listener, uart_forwarder_listener_cb);
ZBUS_CHAN_ADD_OBS(request_channel, uart_forwarder_listener, 0);

bool print_channel_info(const struct zbus_channel *chan)
{
    if (chan == NULL) {
        LOG_ERR("Channel is NULL");
        return false;
    }
    LOG_INF("Channel %s is a %s channel",
            chan->name,
            ZBUS_CHANNEL_IS_SHADOW(chan) ? "shadow" : "master");
    return true;
}

int main(void)
{
    LOG_INF("ZBUS Multidomain UART Forwarder Sample Application");
    zbus_iterate_over_channels(print_channel_info);

    return 0;
}
```
