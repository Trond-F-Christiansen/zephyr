## subsys/zbus/Kconfig.multidomain
```kconfig
#
# Copyright (c) 2025 Nordic Semiconductor ASA
#
# SPDX-License-Identifier: LicenseRef-Nordic-5-Clause
#

menu "ZBUS_MULTIDOMAIN Configuration"

menu "Logging"

	module = ZBUS_MULTIDOMAIN
	module-str = zbus_multidomain
	source "subsys/logging/Kconfig.template.log_config"

endmenu # Log levels

config ZBUS_MULTIDOMAIN_MAX_DOMAIN_NAME_LENGTH
	int "Maximum length of domain names"
	default 32
	help
	  Set the maximum length for domain names used in ZBUS multi-domain.

config ZBUS_MULTIDOMAIN_MAX_MESSAGE_LENGTH
	int "Maximum length of messages in multi-domain ZBUS"
	default 64
	help
	  Set the maximum length for messages in multi-domain ZBUS. Increasing this
	  value allows for larger messages to be sent between domains, but may also
	  increase memory usage and processing time.

config ZBUS_MULTIDOMAIN_FORWARDER_ZBUS_TIMEOUT
	int "Timeout for zbus r/w operations in multi-domain ZBUS in milliseconds"
	default 100
	help
	  Set the timeout for zbus operations in multi-domain ZBUS.

config ZBUS_MULTIDOMAIN_IPC
	bool "IPC backend support for multi-domain ZBUS"
	default n
	select MBOX
	select IPC_SERVICE
	help
	  Enable IPC backend for multi-domain ZBUS. 

if ZBUS_MULTIDOMAIN_IPC

config ZBUS_MULTIDOMAIN_FORWARDER_IPC_TIMEOUT
	int "Timeout for IPC operations in multi-domain ZBUS in milliseconds"
	default 200
	help
	  Set the timeout for IPC operations in multi-domain ZBUS. 

config ZBUS_MULTIDOMAIN_IPC_FORWARDER_THREAD_STACK_SIZE
	int "Stack size for the multi-domain ZBUS forwarder thread"
	default 1024
	help
	  Set the stack size for the thread that handles multi-domain ZBUS forwarding.
config ZBUS_MULTIDOMAIN_IPC_FORWARDER_THREAD_PRIORITY
	int "Priority for the multi-domain ZBUS forwarder thread"
	default 7
	help
	  Set the priority for the thread that handles multi-domain ZBUS forwarding.

endif # ZBUS_MULTIDOMAIN_IPC
endmenu # ZBUS_MULTIDOMAIN
```

## subsys/zbus/multidomain/Kconfig
```kconfig
#
# Copyright (c) 2025 Nordic Semiconductor ASA
#
# SPDX-License-Identifier: LicenseRef-Nordic-5-Clause
#

menu "ZBUS_MULTIDOMAIN Configuration"

module = ZBUS_MULTIDOMAIN
module-str = zbus_multidomain
source "subsys/logging/Kconfig.template.log_config"

config ZBUS_MULTIDOMAIN_MESSAGE_SIZE
    int "ZBus multidomain message size"
    default 256
    range 8 1024
    help
      Configures the size of messages used in ZBus multidomain communication.
      This setting affects the maximum size of messages that can be sent between domains.

config ZBUS_MULTIDOMAIN_CHANNEL_NAME_SIZE
    int "ZBus multidomain channel name size"
    default 32
    range 8 64
    help
      Configures the maximum size of channel names used in ZBus multidomain communication.
      This setting affects how long channel names can be when communicating between domains.

config ZBUS_MULTIDOMAIN_UART
    bool "ZBus multidomain UART backend"
    depends on UART_ASYNC_API
    default n
    help
      Enables the ZBus multidomain UART backend, allowing communication between domains over UART.
      This feature is useful for systems that require inter-domain communication via UART.

if ZBUS_MULTIDOMAIN_UART

config ZBUS_MULTIDOMAIN_UART_BUF_COUNT
    int "ZBus multidomain UART buffer count"
    default 2
    range 2 8
    help
      Configures the number of buffers used for the ZBus multidomain UART backend.

endif # ZBUS_MULTIDOMAIN_UART

config ZBUS_MULTIDOMAIN_IPC
    bool "ZBus multidomain IPC backend"
    depends on MBOX
    depends on IPC_SERVICE
    default n
    help
      Enables the ZBus multidomain IPC backend, allowing communication between domains over IPC.
      This feature is useful for systems that require inter-domain communication via IPC.

endmenu # ZBUS_MULTIDOMAIN Configuration
```
