## tests/subsys/zbus/proxy_agent/proxy_agent/testcase.yaml
```yaml
tests:
  message_bus.zbus.proxy_agent.proxy_agent:
    tags: zbus
    timeout: 180
    integration_platforms:
      - native_sim
    harness: console
    harness_config:
      type: multi_line
      ordered: false
      regex:
        - ".* Failed to send message via proxy agent .*"
        - ".* Sent message pool full, cannot track message ID .*"
        - ".* Unknown channel .*, cannot publish message"
        - ".* Channel .* is not a shadow channel for this proxy agent, cannot publish message"
        - ".* Received NACK for message ID .* remote processing failed"
```
